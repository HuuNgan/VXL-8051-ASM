;DOC ADC VA CHUYEN SANG DIEN AP HIEN THI LEN LCD
;HIEN WARNING NEU DIEN AP LON HON 4.0V
;================================================

LCD_E	BIT	P3.4
LCD_RS	BIT	P3.5
LCDADDR	EQU	6000H
ORG 2000H
MAIN:
    CALL INIT_LCD
LOOP:   
    CALL READ_ADC    
    CALL DISPLAY_VOLTAGE
    JMP LOOP

READ_ADC:
    MOV DPTR, #4000H
    MOV A, #0
    MOVX @DPTR, A
    CALL DELAY100US
    MOVX A, @DPTR
RET

;NHAN GIA TRI ADC TU THANH GHI A, NEN GOI NGAY SAU KHI DOC ADC
DISPLAY_VOLTAGE:
    CJNE A, #204, TT
    MOV F0, C
TT: JNC VOLTAGE

WARNING:
    MOV A, #0C5H
    CALL WRITECOM    ;DUA CON TRO XUONG HANG 2 CAN GIUA
    CALL SENDSTRING

VOLTAGE:
    PUSH ACC
    ANL C, F0
    JC  SKIP
    CALL CLEAR
    MOV A, #0C6H
    CALL WRITECOM    ;DUA CON TRO XUONG HANG 2 CAN GIUA
SKIP:
    POP ACC

    MOV B, #51
    DIV AB
    ADD A, #30H
    CALL WRITETEXT

    MOV A, #'.'
    CALL WRITETEXT

    MOV A, #10
    MUL AB
    MOV C, B.0
    RRC A
    MOV B, #25
    DIV AB
    ADD A, #30H
    CALL WRITETEXT

    MOV A, B
    MOV B, #5
    DIV AB
    ADD A, #30H
    CALL WRITETEXT    
RET

INIT_LCD:
		MOV	A, #38H
		ACALL	WRITECOM
		MOV	A, #0EH
		ACALL	WRITECOM
		MOV	A, #06H
		ACALL	WRITECOM
		RET
CLEAR:
		MOV	A, #01H
		ACALL	WRITECOM		
		RET
WRITECOM:
		MOV	DPTR, #LCDADDR
		SETB	LCD_E
		CLR		LCD_RS
		MOVX	@DPTR, A
		CLR		LCD_E
		ACALL	WAIT_LCD
		RET
WRITETEXT:
		MOV	DPTR, #LCDADDR
		SETB	LCD_E
		SETB	LCD_RS
		MOVX	@DPTR, A
		CLR		LCD_E
		ACALL	WAIT_LCD
		RET
WAIT_LCD:	
		MOV	R6,#10
	DL1:			
		MOV	R7, #250
		DJNZ	R7, $
		DJNZ	R6,DL1
		RET

DELAY100US:
    MOV R7, #50
    DJNZ R7, $
RET

SENDSTRING:
    MOV A, #0
  CONT:
    MOV DPTR, #STRING
    MOV R0, A
    MOVC A, @A+DPTR
    JZ  EXIT
    ACALL WRITETEXT
    MOV A, R0
    INC A
    SJMP CONT
EXIT:
RET

STRING:
    DB "Warning!", 0
END