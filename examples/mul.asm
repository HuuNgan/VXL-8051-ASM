  LCD_E BIT P3.3				 		
  LCD_RS BIT P3.5
  LCDADDR EQU 6000H
  ORG 0000H
BEGIN:
		MOV R1,#0ABH
		MOV @R0, 30H
		MOV DPTR, #LCDADDR
MAIN:	
		ACALL LAYXY
		ACALL CLEAR
		ACALL INIT_LCD	; X=R4, Y=R3
MAIN1:	
		
		MOV A, R4
		MOV B, R3
		MUL AB
		PUSH ACC
		MOV A, R4
		ACALL CAL	
		ACALL DISPLAY
		MOV A,#"x"
		ACALL WRITETEXT
		MOV A, R3
		ACALL CAL
		ACALL DISPLAY
		POP ACC
		ACALL CAL
		ACALL DISPLAYS
		SJMP $ 


DISPLAY:
		MOV A,R1
		ADD A,#30H
		ACALL WRITETEXT
		MOV A,R0
		ADD A,#30H
		ACALL WRITETEXT
		RET
DISPLAYS:
		MOV A,#"="
		ACALL WRITETEXT
		MOV A,R2
		ADD A,#30H
		ACALL WRITETEXT
		MOV A,R1
		ADD A,#30H
		ACALL WRITETEXT
		MOV A,R0
		ADD A,#30H
		ACALL WRITETEXT
		RET		
INIT_LCD:
		MOV A, #38H
		ACALL WRITECOM
		MOV A, #0CH
		ACALL WRITECOM
		MOV A, #06H 
		ACALL WRITECOM
		MOV A,#0C0H
		ACALL WRITECOM
		RET
CLEAR:
		MOV A, #01H; CLR
		ACALL WRITECOM		
		RET
WRITECOM:
		MOV DPTR, #LCDADDR
		SETB LCD_E
		CLR LCD_RS
		MOVX @DPTR, A
		CLR LCD_E
		ACALL WAIT_LCD
		RET
WRITETEXT:
		MOV DPTR, #LCDADDR
		SETB LCD_E
		SETB LCD_RS
		MOVX @DPTR, A
		CLR LCD_E
		ACALL WAIT_LCD
		RET
WAIT_LCD:	
		MOV R6,#10
DL1:	MOV R7, #250
		DJNZ R7, $
		DJNZ R6,DL1
		RET
CAL:
		MOV B,#10
		DIV AB
		MOV R0,B
		MOV B,#10
		DIV AB
		MOV R1,B
		MOV B,#10
		DIV AB
		MOV R2,B
		RET
LAYXY:
		MOV A,R1
		ANL A,#0F0H
		SWAP A
		MOV R4,A
		MOV A,R1
		ANL A,#0FH
		MOV R3,A
		RET

END