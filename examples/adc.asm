;DOC ADC VA XUAT LEN LCD
;======================================================
LCD_E	BIT	P3.4
LCD_RS	BIT	P3.5
LCDADDR	EQU	6000H
ORG 2000H
MAIN:
    CALL INIT_LCD
LOOP:   
    MOV A, #0C7H
    CALL WRITECOM    ;DUA CON TRO XUONG HANG 2 CAN GIUA

    MOV DPTR, #4000H
    MOV A, #0
    MOVX @DPTR, A
    CALL DELAY100US
    MOVX A, @DPTR
    
    MOV B, #100
    DIV AB
    ADD A, #30H
    CALL WRITETEXT
    MOV A, B
    MOV B, #10
    DIV AB
    ADD A, #30H
    CALL WRITETEXT
    MOV A, B
    ADD A, #30H
    CALL WRITETEXT

    JMP LOOP

INIT_LCD:
		MOV	A, #38H
		ACALL	WRITECOM
		MOV	A, #0EH
		ACALL	WRITECOM
		MOV	A, #06H
		ACALL	WRITECOM
		RET
CLEAR:
		MOV	A, #01H
		ACALL	WRITECOM		
		RET
WRITECOM:
		MOV	DPTR, #LCDADDR
		SETB	LCD_E
		CLR		LCD_RS
		MOVX	@DPTR, A
		CLR		LCD_E
		ACALL	WAIT_LCD
		RET
WRITETEXT:
		MOV	DPTR, #LCDADDR
		SETB	LCD_E
		SETB	LCD_RS
		MOVX	@DPTR, A
		CLR		LCD_E
		ACALL	WAIT_LCD
		RET
WAIT_LCD:	
		MOV	R6,#10
	DL1:			
		MOV	R7, #250
		DJNZ	R7, $
		DJNZ	R6,DL1
		RET

DELAY100US:
    MOV R7, #50
    DJNZ R7, $
RET
END