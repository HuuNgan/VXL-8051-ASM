;LAY X,Y TU R1. X LA BYTE CAO, Y LA BYTE THAP
;TINH X*Y VA XUAT KET QUA LEN LCD
;================================================
LCD_E	BIT	P3.4
LCD_RS	BIT	P3.5
LCDADDR	EQU	6000H
ORG 2000H
MAIN:
    MOV R1, #0FFH

    CALL INIT_LCD
    CALL MUL_XY
    CALL DISPLAY

MUL_XY:
    MOV A, #0FH
    ANL A, R1
    MOV B, A
    MOV A, #0F0H
    ANL A, R1
    SWAP A
    MUL AB
RET

DISPLAY:
    MOV B, #100
    DIV AB
    ADD A, #30H
    CALL WRITETEXT
    MOV A, B
    MOV B, #10
    DIV AB
    ADD A, #30H
    CALL WRITETEXT
    MOV A, B
    ADD A, #30H
    CALL WRITETEXT
RET

INIT_LCD:
		MOV	A, #38H
		ACALL	WRITECOM
		MOV	A, #0EH
		ACALL	WRITECOM
		MOV	A, #06H
		ACALL	WRITECOM
		RET
CLEAR:
		MOV	A, #01H
		ACALL	WRITECOM		
		RET
WRITECOM:
		MOV	DPTR, #LCDADDR
		SETB	LCD_E
		CLR		LCD_RS
		MOVX	@DPTR, A
		CLR		LCD_E
		ACALL	WAIT_LCD
		RET
WRITETEXT:
		MOV	DPTR, #LCDADDR
		SETB	LCD_E
		SETB	LCD_RS
		MOVX	@DPTR, A
		CLR		LCD_E
		ACALL	WAIT_LCD
		RET
WAIT_LCD:	
		MOV	R6,#10
	DL1:			
		MOV	R7, #250
		DJNZ	R7, $
		DJNZ	R6,DL1
		RET

END