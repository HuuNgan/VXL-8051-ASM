LCD_E	BIT	P3.4
LCD_RS	BIT	P3.5
LCDADDR	EQU	6000H
ORG 2000H
MAIN:
    CALL INIT_LCD
    MOV R0, #0
    MOV A, #83H
    CALL WRITECOM
    MOV A, #'C'
    CALL WRITETEXT
    MOV A, #'o'
    CALL WRITETEXT
    MOV A, #'u'
    CALL WRITETEXT
    MOV A, #'n'
    CALL WRITETEXT
    MOV A, #'t'
    CALL WRITETEXT
    MOV A, #':'
    CALL WRITETEXT

LOOP:
    MOV A, #8AH
    CALL WRITECOM
    MOV A, R0
    CALL DISPLAY_COUNT
CHECK:
    JB P1.0, $
    CALL DELAY50MS
    JB P1.0, CHECK
    INC R0
    ;JNB P1.0, $
    CJNE R0, #101, LOOP
    CALL CLEAR
    MOV A, #83H
    CALL WRITECOM
    CALL SENDSTRING 
    SJMP $

DISPLAY_COUNT:
;INPUT FROM A 
    MOV B, #100
    DIV AB
    ADD A, #30H
    CALL WRITETEXT
    
    MOV A, B
    MOV B, #10
    DIV AB
    ADD A, #30H
    CALL WRITETEXT

    MOV A, B
    ADD A, #30H
    CALL WRITETEXT
RET

INIT_LCD:
		MOV	A, #38H
		ACALL	WRITECOM
		MOV	A, #0EH
		ACALL	WRITECOM
		MOV	A, #06H
		ACALL	WRITECOM
		RET
CLEAR:
		MOV	A, #01H
		ACALL	WRITECOM		
		RET
WRITECOM:
		MOV	DPTR, #LCDADDR
		SETB	LCD_E
		CLR		LCD_RS
		MOVX	@DPTR, A
		CLR		LCD_E
		ACALL	WAIT_LCD
		RET
WRITETEXT:
		MOV	DPTR, #LCDADDR
		SETB	LCD_E
		SETB	LCD_RS
		MOVX	@DPTR, A
		CLR		LCD_E
		ACALL	WAIT_LCD
		RET
WAIT_LCD:	
		MOV	R6,#10
	DL1:			
		MOV	R7, #250
		DJNZ	R7, $
		DJNZ	R6,DL1
		RET
SENDSTRING:
    MOV A, #0
  CONT:
    MOV DPTR, #STRING
    MOV R0, A
    MOVC A, @A+DPTR
    JZ  EXIT
    ACALL WRITETEXT
    MOV A, R0
    INC A
    SJMP CONT
EXIT:
RET

DELAY50MS:
    MOV R7, #100
DL:
    MOV R6, #250
    DJNZ R6, $
    DJNZ R7, DL
RET

STRING:
    DB "Overload!", 0

END