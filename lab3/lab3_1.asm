LCD_E	BIT	P3.3        ;doi thanh P3.4 neu dung tren proteus
LCD_RS	BIT	P3.5
LCDADDR	EQU	6000H
ORG	0000H
MAIN:		
    MOV	DPTR, #LCDADDR
    ACALL	CLEAR
    ACALL	INIT_LCD
    ACALL	DISPLAYSTRING
    SJMP	$

INIT_LCD:
    MOV	A, #38H
    ACALL	WRITECOM
    MOV	A, #0EH
    ACALL	WRITECOM
    MOV	A, #06H
    ACALL	WRITECOM
RET

CLEAR:
    MOV	A, #01H
    ACALL	WRITECOM		
RET

WRITECOM:
    MOV	DPTR, #LCDADDR
    SETB	LCD_E
    CLR		LCD_RS
    MOVX	@DPTR, A
    CLR		LCD_E
    ACALL	WAIT_LCD
RET

WRITETEXT:
    MOV	DPTR, #LCDADDR
    SETB	LCD_E
    SETB	LCD_RS
    MOVX	@DPTR, A
    CLR		LCD_E
    ACALL	WAIT_LCD
RET

DISPLAYSTRING:
    MOV		A,#0		
LOOP:
    MOV		DPTR, #MESSAGE
    MOV		R0,A
    MOVC	A,@A+DPTR
    JZ		EXIT
    ACALL	WRITETEXT
    MOV		A,R0
    INC		A
    DJNZ	B,	LOOP
EXIT:			
RET

WAIT_LCD:	
    MOV	R6,#10
DL1:			
    MOV	R7, #250
    DJNZ	R7, $
    DJNZ	R6,DL1
RET

MESSAGE:
    DB	"HUU NGAN",0		
END
