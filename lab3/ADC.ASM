	LCD_E	BIT	P3.3
	LCD_RS	BIT	P3.5
	LCDADDR	EQU	6000H
	ORG	2000H
	MAIN:
		
		MOV		@R0, 30H
		MOV	DPTR, #LCDADDR
		ACALL	CLEAR
		ACALL	INIT_LCD
		ACALL	READ_ADC
		ACALL	CHUYEN_DOI
		;ACALL	DELAY_1S
		SJMP	MAIN

	READ_ADC:
		MOV		A,#0
		MOV		DPTR,#4000H
		MOVX	@DPTR,A
		ACALL	DELAY_100US
		MOVX	A,@DPTR
		MOV		R0,A
		RET 

	CHUYEN_DOI:
		MOV		B,#51
		DIV		AB
		ADD		A,#30H
		ACALL	WRITETEXT

		MOV		A,#'.'
		ACALL	WRITETEXT

		MOV		A,B
		MOV		B,#10
		MUL		AB
		MOV		C,B.0
		RRC		A
		MOV		B,#25
		DIV		AB
		ADD		A,#30H
		ACALL	WRITETEXT

		MOV		A,B
		MOV		B,#10
		MUL		AB
		MOV		C,B.0
		RRC		A
		MOV		B,#25
		DIV		AB
		ADD		A,#30H
		ACALL	WRITETEXT
		
		
		
	INIT_LCD:
		MOV	A, #38H
		ACALL	WRITECOM
		MOV	A, #0EH
		ACALL	WRITECOM
		MOV	A, #06H
		ACALL	WRITECOM
		RET
	CLEAR:
		MOV	A, #01H
		ACALL	WRITECOM		
		RET
	WRITECOM:
		MOV	DPTR, #LCDADDR
		SETB	LCD_E
		CLR		LCD_RS
		MOVX	@DPTR, A
		CLR		LCD_E
		ACALL	WAIT_LCD
		RET
	WRITETEXT:
		MOV	DPTR, #LCDADDR
		SETB	LCD_E
		SETB	LCD_RS
		MOVX	@DPTR, A
		CLR		LCD_E
		ACALL	WAIT_LCD
		RET
	DISPLAYSTRING:
		MOV		A,#0		
	LOOP:
		MOV		DPTR, #MESSAGE
		MOV		R0,A
		MOVC	A,@A+DPTR
		JZ		EXIT
		ACALL	WRITETEXT
		MOV		A,R0
		INC		A
		DJNZ	B,	LOOP
	EXIT:			
		RET
	WAIT_LCD:	
		MOV	R6,#10
	DL1:			
		MOV	R7, #250
		DJNZ	R7, $
		DJNZ	R6,DL1
		RET
	MESSAGE:
		DB	"HELLO WORLD!",0
	DELAY_100US:
		MOV		R7,#50
		DJNZ	R7,$
		RET
			
	DELAY_1S:
		MOV		R7,#8
	LAP1:
		MOV		R6,#250
	LAP2:
		MOV		R5,#250
		DJNZ	R5,$
		DJNZ	R6,LAP2
		DJNZ	R7,LAP1
		RET

		END